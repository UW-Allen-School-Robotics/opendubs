// DEVICE ONLY. Everything below needs ESP-IDF -- Wi-Fi, NVS, OTA, FreeRTOS -- so on the desktop
// SDL build it compiles to stubs instead. ESP_PLATFORM is defined by the IDF build and by nothing
// else, which is what makes it the right guard.
//
// The desktop build exists so the face and the touch UI can be judged and iterated at full frame
// rate with a mouse, with no flashing and nobody standing at the bench. A network stack is not
// part of that, and "no link" is a state the face already renders honestly, so stubbing this out
// costs the desktop build nothing it needs.
#ifdef ESP_PLATFORM

#include "net.h"

#include <esp_event.h>
#include <esp_netif.h>
#include <esp_wifi.h>
#include <esp_wifi_default.h>
#include <freertos/FreeRTOS.h>
#include <freertos/task.h>
#include <mooncake_log.h>
#include <nvs_flash.h>
#include <esp_app_desc.h>
#include <esp_https_ota.h>
#include <esp_ota_ops.h>
#include <lwip/sockets.h>
#include <cstdio>
#include <cstring>

// Generated by build.sh from OPENDUBS_WIFI_SSID / OPENDUBS_WIFI_PASS. Defines
// OPENDUBS_WIFI_SSID as a string literal, or leaves it undefined when none was supplied.
// The generated file lands in the EPHEMERAL build tree and is never written to this repo.
#include "net_credentials.h"
#include "rollback_test.h"
#include <mdns.h>
#include "shared/clock.h"
#include "ui_hmi.h"
#include "net_cmd.h"
#include "pantilt.h"
#include "tof.h"

// Patched into the vendor BSP's lvgl_read_cb by build.sh (patches/gt911_rawcount.c.inc). These
// count what the GT911 DRIVER delivers, before hit-testing -- the layer between the chip and the
// widget that has never been observed. Defined in a C file, hence extern "C".
extern "C" {
extern volatile uint32_t od_tp_polls, od_tp_presses, od_tp_errs, od_tp_lastx, od_tp_lasty;
}

namespace {

constexpr const char* kTag = "net";

// Declared here rather than beside the listener: the mDNS service record advertises this port
// and is set up earlier in the file.
constexpr int kCmdPort = 4242;

// The StamPLC's own command port. We send it two things and nothing else: a Z-axis INTENT and an
// e-stop request -- both as plain text, exactly as the dashboard does.
//
// NOT the Arduino's route. That one sent CAN_ID_LIFT_CMD (0x102) to the Thor on 5006 and relied on
// the Thor to translate, so RAISE/LOWER silently did nothing whenever the dashboard was down. The
// StamPLC parses no such frame; what it parses is `MAST CMD <-1..1>`, which feeds the SAME
// setIntent() the sticks do, so the pinch guard, the limits and the belief correction all apply.
// Its own comment calls that "deliberately the ONLY remote way to move the lift" and names the
// head's buttons as an expected operator interface. So this is shorter AND safer.
constexpr int      kPlcCmdPort  = 5005;
constexpr uint32_t kLiftHoldMs  = 300;   // a request older than this is treated as released
constexpr uint32_t kPubMs       = 50;    // 20 Hz, matching the StamPLC's 250 ms heartbeat window

// The StamPLC's address is RESOLVED BY NAME, never configured -- `opendubs-stamplc.local`, which
// the StamPLC already advertises (verified: 10.42.2.20 on the robot, 2026-10-06). No fixed IP, no
// new setting, no change to the StamPLC.
//
// LEARNING IT FROM THE 0x107 RATE FRAME IS NOT ENOUGH, and that is worth stating because it was
// the first design: the StamPLC sends that frame *only while someone is actively aiming the head*
// -- silence is deliberately how it releases its claim. So an address learned that way does not
// exist until an operator has moved the right stick, and a SOFT E-STOP THAT ONLY WORKS AFTER YOU
// HAVE AIMED THE HEAD is not an e-stop. Name resolution has no such precondition. The frame is
// still honoured when it arrives, because a packet in hand beats a cached lookup.
volatile uint32_t g_plcIp     = 0;
volatile uint32_t g_plcStamp  = 0;
volatile float    g_liftReq   = 0.0f;    // -1 lower, +1 raise, 0 stop
volatile uint32_t g_liftMs    = 0;
volatile bool     g_estopReq  = false;
volatile bool     g_plcByName = false;   // resolved rather than heard
volatile uint32_t g_plcTelem  = 0;       // JSON telemetry lines accepted
const char*       g_liftWhy    = nullptr; // why the lift would refuse; nullptr == it would not
uint32_t          g_liftGateStamp = 0;

// The robot state now lives in net_cmd.cpp, shared with the twin, and is written through
// netSetState(). The telemetry listener below is one of its two writers; `STATE <NAME>` is the
// other, and both targets parse that line with the same code.

// OTA IN PROGRESS. The face quiesces while this is set -- see netOtaActive(). The OTA runs on this
// task at priority 2 while the LVGL task runs at priority 4 and the face is already measured at
// 107-112% of its frame budget, so without this the download competes with rendering and loses.
volatile bool g_otaActive = false;

// Deliberately NOT including <hal/hal.h> here, and this is not fussiness.
//
// `app/hal/hal.h` itself does `#include <lvgl.h>`. So a module that reaches for
// GetHAL()->millis() pulls the entire LVGL API into a layer that is supposed to be unable to name
// an LVGL symbol -- WHILE PASSING a grep for `#include <lvgl.h>`. That is AUDIT.md invariant 1
// defeated one level of indirection down, and it is exactly how face_probe.cpp ended up claiming
// in its own header comment to be pure compute while transitively including LVGL.
//
// esp_timer and the FreeRTOS tick are enough for everything here.
uint32_t nowMs()
{
    return (uint32_t)(xTaskGetTickCount() * portTICK_PERIOD_MS);
}

void logVisibleAps();        // defined below; called from the disconnect handler
char g_status[64] = "wifi: idle";
bool g_ready      = false;
int  g_failures   = 0;

void setStatus(const char* s)
{
    strncpy(g_status, s, sizeof(g_status) - 1);
    g_status[sizeof(g_status) - 1] = 0;
}

// Resolve the StamPLC by name, and keep doing so. Its own task because mdns_query_a() blocks for
// up to its timeout, and the command socket's loop is also the 20 Hz lift publisher -- a two-second
// stall there would be two seconds of a held RAISE button not being sent.
// Derive the robot state from the StamPLC's own telemetry, which it ALREADY BROADCASTS.
//
// The state chip had no source: it only ever moved on an inbound `STATE <NAME>`, and nothing on
// this robot sends one -- the Arduino got state as CAN_ID_ROBOT_STATE from the Thor's dashboard,
// so with the dashboard down the chip simply never changed. The StamPLC, meanwhile, broadcasts a
// JSON line to 255.255.255.255:5005 about three times a second carrying rc.mode and io.estop,
// which is exactly the authority we want: the StamPLC owns the contactor, not the Thor.
//
// So we LISTEN. No StamPLC change, no dashboard dependency, and the state comes from the device
// that actually decides it. ~43 packets a second arrive on that port, almost all of them the
// firmware's own `[TAG] ...` text telemetry, so the first byte is the filter.
// The exact strings netTelemetry() emits, and nothing else: OFF, MANUAL, AUTO, ESTOP, FAILSAFE,
// NOLINK. My first version matched MANUAL_LIVE/MANUAL_SAFE -- the StamPLC's INTERNAL enum names,
// which never appear in the JSON -- so "MANUAL" fell through and mapped to nothing.
const char* plcStateFromJson(const char* j)
{
    // io.estop wins outright: it is the latch, and a mode string can lag it.
    const char* e = strstr(j, "\"estop\":");
    if (e && strncmp(e + 8, "true", 4) == 0) return "E_STOP";

    const char* m = strstr(j, "\"mode\":\"");
    if (!m) return nullptr;
    m += 8;
    if (strncmp(m, "ESTOP",       5) == 0) return "E_STOP";
    if (strncmp(m, "NOLINK",      6) == 0) return "DEGRADED";
    if (strncmp(m, "FAILSAFE",    8) == 0) return "DEGRADED";
    if (strncmp(m, "MANUAL",      6) == 0) return "MANUAL";
    if (strncmp(m, "AUTO",        4) == 0) return "AUTONOMOUS";
    if (strncmp(m, "OFF",         3) == 0) return "SAFE_IDLE";
    return nullptr;
}

// WHY THE LIFT WOULD REFUSE, in the operator's terms. The StamPLC zeroes mastIntent unless armOK,
// and a button that silently does nothing is the worst of both worlds -- so the head works out the
// reason from the same telemetry line and the panel says it.
//
// This mirrors armOK rather than duplicating its authority: the StamPLC still decides, and this is
// only ever an explanation. g_driveSafe is not in the telemetry, so a refusal with every visible
// gate satisfied is possible; the wording says "the robot is refusing" rather than claiming to
// know everything.
void plcGateFromJson(const char* j)
{
    const char* m = strstr(j, "\"mode\":\"");
    const char* e = strstr(j, "\"estop\":");
    const char* r = strstr(j, "\"relay\":");
    const bool  estop = e && strncmp(e + 8, "true", 4) == 0;
    const int   relay = r ? atoi(r + 8) : 0;
    const bool  contactor = (relay & 0x01) != 0;        // RELAY1/R0 is the e-stop contactor

    const char* why = nullptr;
    if (estop)                                      why = "clear the e-stop at the dashboard";
    else if (!m)                                    why = "no robot state";
    else if (strncmp(m + 8, "ESTOP",    5) == 0)    why = "clear the e-stop at the dashboard";
    else if (strncmp(m + 8, "NOLINK",   6) == 0)    why = "transmitter is off or out of range";
    else if (strncmp(m + 8, "FAILSAFE", 8) == 0)    why = "RC failsafe - check the transmitter";
    else if (strncmp(m + 8, "OFF",      3) == 0)    why = "set CH5 to MANUAL";
    else if (!contactor)                            why = "close the contactor";
    g_liftWhy = why;                                 // nullptr == allowed
}

void plcTelemetryTask(void*)
{
    const int s = socket(AF_INET, SOCK_DGRAM, IPPROTO_IP);
    if (s < 0) { mclog::tagError(kTag, "telemetry socket() failed"); vTaskDelete(nullptr); return; }
    int one = 1;
    setsockopt(s, SOL_SOCKET, SO_REUSEADDR, &one, sizeof(one));
    setsockopt(s, SOL_SOCKET, SO_BROADCAST, &one, sizeof(one));
    sockaddr_in me = {};
    me.sin_family      = AF_INET;
    me.sin_addr.s_addr = htonl(INADDR_ANY);
    me.sin_port        = htons(kPlcCmdPort);
    if (bind(s, (sockaddr*)&me, sizeof(me)) < 0) {
        mclog::tagError(kTag, "telemetry bind({}) failed", kPlcCmdPort);
        close(s); vTaskDelete(nullptr); return;
    }
    mclog::tagInfo(kTag, "listening for stamplc telemetry on udp/{}", kPlcCmdPort);

    char rx[1024];
    for (;;) {
        sockaddr_in from; socklen_t fl = sizeof(from);
        const int n = recvfrom(s, rx, sizeof(rx) - 1, 0, (sockaddr*)&from, &fl);
        if (n <= 0) { vTaskDelay(pdMS_TO_TICKS(5)); continue; }
        if (rx[0] != '{') continue;                 // the cheap filter: text telemetry, not state
        rx[n] = 0;
        g_plcTelem++;
        plcGateFromJson(rx);
        g_liftGateStamp = perceptNowMs();
        const char* st = plcStateFromJson(rx);
        if (!st) continue;
        const char* cur = nullptr;
        if (!linkState(&cur, nullptr) || strcmp(cur, st) != 0)
            mclog::tagInfo(kTag, "state <- {} (stamplc telemetry)", st);
        netSetState(st);
    }
}

void plcResolveTask(void*)
{
    for (;;) {
        if (!g_ready) { vTaskDelay(pdMS_TO_TICKS(2000)); continue; }
        esp_ip4_addr_t a = {};
        const esp_err_t e = mdns_query_a("opendubs-stamplc", 2000, &a);
        if (e == ESP_OK && a.addr != 0) {
            if (g_plcIp != a.addr || !g_plcByName)
                mclog::tagInfo(kTag, "stamplc at " IPSTR " (by name)", IP2STR(&a));
            // A frame in hand beats a lookup: do not overwrite an address we actually heard from
            // unless it has gone quiet for a while.
            const uint32_t now = (uint32_t)(esp_timer_get_time() / 1000);
            if (g_plcByName || g_plcIp == 0 || (now - g_plcStamp) > 30000) {
                g_plcIp     = a.addr;
                g_plcStamp  = now;
                g_plcByName = true;
            }
            vTaskDelay(pdMS_TO_TICKS(30000));     // confirm occasionally; DHCP can move it
        } else {
            vTaskDelay(pdMS_TO_TICKS(5000));      // not up yet, or not on this network
        }
    }
}

void cmdTask(void*);        // defined below; started once we hold an IP
void plcResolveTask(void*);
void plcTelemetryTask(void*);
void markValidTask(void*);  // defined below; declares the image good once it has proven healthy

void onWifi(void*, esp_event_base_t base, int32_t id, void* data)
{
    if (base == WIFI_EVENT && id == WIFI_EVENT_STA_START) {
        setStatus("wifi: associating");
        mclog::tagInfo(kTag, "associating");
        esp_wifi_connect();
        return;
    }
    if (base == WIFI_EVENT && id == WIFI_EVENT_STA_DISCONNECTED) {
        g_ready = false;
        auto* d = (wifi_event_sta_disconnected_t*)data;
        char b[64];
        // The REASON matters and is worth surfacing: "wrong password" (reason 15/205) and "no such
        // network" (201) are different problems for whoever is standing at the bench, and a bare
        // "disconnected" sends them looking in the wrong place.
        ++g_failures;
        // 201 = NO_AP_FOUND (that network is not here), 15/205 = auth failure (wrong password).
        // Different problems, different places to look, so name them rather than print a number.
        const int rs = d ? d->reason : -1;
        const char* why = (rs == 201) ? "not found" : (rs == 15 || rs == 205) ? "bad password" : "disconnected";
        snprintf(b, sizeof(b), "wifi: %s (reason %d, %d fails)", why, rs, g_failures);
        setStatus(b);
        // ALSO TO THE CONSOLE, and that is a fix rather than noise. The reason previously went
        // ONLY to the panel string -- and that string is appended to the face's label by
        // applyEmote(), which re-runs only on a state or emote change. With no StamPLC link the
        // label is a boot-time snapshot, so the panel sat on "wifi: idle" (the buffer's INITIAL
        // value, never overwritten) while the radio retried in a loop. The one number that
        // identifies the fault was therefore unreachable by either route.
        mclog::tagError(kTag, "disconnected: {} (reason {}), {} failures", why, rs, g_failures);
        // After a few failures, say what IS out there. Costs one scan, once, and it is the only
        // thing that distinguishes "wrong SSID" from "AP down" without guessing.
        if (g_failures == 3) logVisibleAps();
        // Back off rather than hammer: a wrong password retried at full speed is indistinguishable
        // from an attack to an access point, and some will blacklist the MAC.
        vTaskDelay(pdMS_TO_TICKS(g_failures < 5 ? 2000 : 15000));
        esp_wifi_connect();
        return;
    }
    if (base == IP_EVENT && id == IP_EVENT_STA_GOT_IP) {
        auto* e = (ip_event_got_ip_t*)data;
        char  b[64];
        snprintf(b, sizeof(b), "wifi: " IPSTR, IP2STR(&e->ip_info.ip));
        setStatus(b);
        g_ready    = true;
        g_failures = 0;
        // Start the listener only now: binding before association just fails.
        static bool started = false;
        if (!started) {
            started = true;
            xTaskCreatePinnedToCore(cmdTask, "netcmd", 6144, nullptr, 2, nullptr, 1);
            xTaskCreatePinnedToCore(plcResolveTask, "plcres", 4096, nullptr, 1, nullptr, 1);
            xTaskCreatePinnedToCore(plcTelemetryTask, "plctel", 4096, nullptr, 2, nullptr, 1);
        }
        // {} NOT IPSTR. IPSTR is a printf format ("%d.%d.%d.%d") and mclog is fmt-style, so the
        // tokens printed literally and the address never appeared -- the one line someone needs in
        // order to OTA to the head.
        mclog::tagInfo(kTag, "got ip {}.{}.{}.{}", IP2STR(&e->ip_info.ip));
    }
}

void task(void*)
{
    // Let the face build its scene before we allocate network buffers.
    vTaskDelay(pdMS_TO_TICKS(2500));

    esp_err_t r = nvs_flash_init();
    if (r == ESP_ERR_NVS_NO_FREE_PAGES || r == ESP_ERR_NVS_NEW_VERSION_FOUND) {
        // NOT erasing. The vendor's wifi_init() calls nvs_flash_erase() here, which would destroy
        // exactly the stored credentials we are about to look for -- and any per-robot values
        // sitting in the same namespace. If NVS is genuinely unusable, say so and stop; a human
        // can erase deliberately.
        setStatus("wifi: NVS unusable - not erasing");
        mclog::tagError(kTag, "nvs_flash_init: {} -- refusing to erase", esp_err_to_name(r));
        vTaskDelete(nullptr);
        return;
    }

    // Tolerate already-initialised: the demo may have brought these up before us.
    r = esp_netif_init();
    if (r != ESP_OK && r != ESP_ERR_INVALID_STATE) { setStatus("wifi: netif init failed"); vTaskDelete(nullptr); return; }
    r = esp_event_loop_create_default();
    if (r != ESP_OK && r != ESP_ERR_INVALID_STATE) { setStatus("wifi: event loop failed"); vTaskDelete(nullptr); return; }

    esp_netif_create_default_wifi_sta();

    wifi_init_config_t cfg = WIFI_INIT_CONFIG_DEFAULT();
    if (esp_wifi_init(&cfg) != ESP_OK) { setStatus("wifi: esp_wifi_init failed"); vTaskDelete(nullptr); return; }

    esp_event_handler_register(WIFI_EVENT, ESP_EVENT_ANY_ID, onWifi, nullptr);
    esp_event_handler_register(IP_EVENT, IP_EVENT_STA_GOT_IP, onWifi, nullptr);

    // FLASH storage, so esp_wifi reads whatever is already provisioned -- including anything the
    // Arduino firmware left behind, since it wrapped esp_wifi and persisted to the same
    // nvs.net80211 namespace, and `nvs` is still at 0x9000/0x5000 byte-for-byte.
    esp_wifi_set_storage(WIFI_STORAGE_FLASH);
    esp_wifi_set_mode(WIFI_MODE_STA);

    // Does NVS already hold an SSID? Read it back rather than assume either way.
    wifi_config_t have = {};
    const bool stored = esp_wifi_get_config(WIFI_IF_STA, &have) == ESP_OK && have.sta.ssid[0] != 0;

#ifdef OPENDUBS_WIFI_SSID
    // EXPLICIT INTENT OVERRIDES STORED. The first version only applied build-time credentials
    // when NVS was empty -- which made the provisioning path useless in the one situation that
    // actually occurs: NVS already holds credentials for a DIFFERENT network (the robot's), and
    // someone is trying to move the board to a new one. Passing OPENDUBS_WIFI_SSID is a deliberate
    // act; it should win over whatever was left behind.
    {
        wifi_config_t c = {};
        strncpy((char*)c.sta.ssid, OPENDUBS_WIFI_SSID, sizeof(c.sta.ssid) - 1);
        strncpy((char*)c.sta.password, OPENDUBS_WIFI_PASS, sizeof(c.sta.password) - 1);
        esp_wifi_set_config(WIFI_IF_STA, &c);
        char b[64];
        snprintf(b, sizeof(b), "wifi: provisioning '%s'", (const char*)OPENDUBS_WIFI_SSID);
        setStatus(b);
        mclog::tagInfo(kTag, "provisioning '{}' from build-time credentials -- overriding{}",
                       OPENDUBS_WIFI_SSID, stored ? " the stored network" : " nothing stored");
    }
#else
    if (!stored) {
        // Say exactly what to do. "no credentials" alone sends someone reading source.
        setStatus("wifi: none stored - build with OPENDUBS_WIFI_SSID/PASS");
        mclog::tagError(kTag, "no stored credentials and none compiled in");
        vTaskDelete(nullptr);
        return;
    }
#endif

    if (stored) {
        // Show WHICH network it is hunting for. "retry (reason 201)" alone is ambiguous between
        // "wrong password", "out of range" and "configured for a different site" -- and on this
        // board the stored SSID is usually the robot's network, which is simply not present at a
        // desk. Naming it turns a confusing retry loop into an obvious one.
        char b[64];
        snprintf(b, sizeof(b), "wifi: seeking '%s'", (char*)have.sta.ssid);
        setStatus(b);
        mclog::tagInfo(kTag, "using credentials already in NVS: ssid '{}'", (char*)have.sta.ssid);
    }

    // ADVERTISE A NAME, so nothing has to be told the head's address.
    //
    // opendubs-stamplc.local and opendubs2.local already resolve on this network -- the head was
    // the only device without a name, which is exactly why the StamPLC link needs a configured
    // TAB5IP and why a DHCP change silently kills RC head control. The Arduino firmware intended
    // this (ArduinoOTA.setHostname("opendubs-tab5")) but hung it on ArduinoOTA, which never worked
    // on this board because its listener sits behind the ESP-Hosted co-processor.
    //
    // The service record is advertised as well as the hostname: it makes the UDP command port
    // discoverable by browsing rather than by resolving a name someone has to know.
    {
        esp_err_t e = mdns_init();
        if (e != ESP_OK) {
            mclog::tagError(kTag, "mdns_init failed: {}", esp_err_to_name(e));
        } else {
            mdns_hostname_set("opendubs-tab5");
            mdns_instance_name_set("OpenDubs head");
            mdns_service_add(NULL, "_opendubs", "_udp", kCmdPort, NULL, 0);
            mclog::tagInfo(kTag, "mdns: opendubs-tab5.local, _opendubs._udp on {}", kCmdPort);
        }
    }

    setStatus("wifi: starting");
    if (esp_wifi_start() != ESP_OK) { setStatus("wifi: start failed"); vTaskDelete(nullptr); return; }

    // The event handlers drive everything from here.
    vTaskDelete(nullptr);
}

// WHAT THE RADIO CAN SEE, logged ONCE after association keeps failing.
//
// Not at every boot: ten AP lines on a healthy boot is noise. But a NO_AP_FOUND loop is exactly
// the case where the SSID we were told to join and the SSID that exists may differ, and no amount
// of reasoning settles that -- only the radio can. This is what found it: the head was asked for
// 'opendubs' while the air carried 'Opendubs2' at -37 dBm, and reason 201 had been correct all
// along while three different theories were proposed about bands and hidden networks.
void logVisibleAps()
{
    wifi_scan_config_t sc = {};
    sc.show_hidden = true;
    const esp_err_t se = esp_wifi_scan_start(&sc, true);   // blocking
    if (se != ESP_OK) {
        mclog::tagError(kTag, "scan failed: {}", esp_err_to_name(se));
        return;
    }
    uint16_t n = 0;
    esp_wifi_scan_get_ap_num(&n);
    mclog::tagInfo(kTag, "cannot associate; the radio can see {} APs:", (int)n);
    if (n > 20) n = 20;
    static wifi_ap_record_t recs[20];
    if (esp_wifi_scan_get_ap_records(&n, recs) == ESP_OK)
        for (int i = 0; i < (int)n; ++i)
            mclog::tagInfo(kTag, "  '{}' ch{} rssi {} auth {}", (const char*)recs[i].ssid,
                           (int)recs[i].primary, (int)recs[i].rssi, (int)recs[i].authmode);
}

// ------------------------------------------------------------------------------------------
// STAGE 2: the UDP command listener, and STAGE 3: OTA by HTTP pull.
//
// Port 4242 and a line-oriented text protocol, matching the Arduino firmware exactly so
// ota-from-thor.sh keeps working. That firmware never used ArduinoOTA either -- its listener sits
// behind the ESP-Hosted co-processor and fails silently -- so the robot has always been flashed by
// being TOLD to pull, and that is what we reproduce.
// ------------------------------------------------------------------------------------------
// kCmdPort is declared earlier: mDNS advertises it before this point in the file.

// The last STATE we were told, and when. Never parsed into an index here -- see net.h.

// THE STALL DEADLINE IS NOT OPTIONAL. The Arduino firmware carries a comment paid for in a
// physical recovery: killing the serving side mid-download wedged the head on "OTA: writing",
// network task and all, recoverable only by pulling power. Nothing that writes firmware may be
// able to hang the device it runs on.
constexpr uint32_t kStallMs = 10000;

void doOta(const char* url)
{
    char b[64];
    snprintf(b, sizeof(b), "OTA: connecting");
    setStatus(b);
    mclog::tagInfo(kTag, "OTA pull from {}", url);

    esp_http_client_config_t http = {};
    http.url                = url;
    http.timeout_ms         = 8000;
    http.keep_alive_enable  = true;

    esp_https_ota_config_t cfg = {};
    cfg.http_config = &http;

    esp_https_ota_handle_t h = nullptr;
    g_otaActive = true;
    if (esp_https_ota_begin(&cfg, &h) != ESP_OK || !h) {
        g_otaActive = false;
        setStatus("OTA: begin failed");
        mclog::tagError(kTag, "esp_https_ota_begin failed");
        return;
    }

    // THE NON-BLOCKING FORM, deliberately. esp_https_ota_perform() returns
    // ESP_ERR_HTTPS_OTA_IN_PROGRESS and expects to be called again, so the loop -- and therefore
    // the deadline -- stays ours. The one-shot esp_https_ota() convenience call hides the loop,
    // and hiding the loop is how the original wedge happened. Do not "simplify" this.
    int      lastLen  = -1;
    uint32_t lastMove = nowMs();
    int      pct      = -1;
    const int total   = esp_https_ota_get_image_size(h);

    for (;;) {
        const esp_err_t r = esp_https_ota_perform(h);
        if (r != ESP_ERR_HTTPS_OTA_IN_PROGRESS) {
            if (r != ESP_OK) {
                snprintf(b, sizeof(b), "OTA: failed (%s)", esp_err_to_name(r));
                setStatus(b);
                esp_https_ota_abort(h);
                g_otaActive = false;
                return;
            }
            break;
        }

        const int len = esp_https_ota_get_image_len_read(h);
        if (len != lastLen) { lastLen = len; lastMove = nowMs(); }
        else if ((int32_t)(nowMs() - (lastMove + kStallMs)) >= 0) {
            setStatus("OTA: stalled - aborted");
            mclog::tagError(kTag, "no progress for {} ms, aborting", (int)kStallMs);
            esp_https_ota_abort(h);
            g_otaActive = false;
            return;
        }

        if (total > 0) {
            const int p = len * 100 / total;
            if (p != pct) { pct = p; snprintf(b, sizeof(b), "OTA: %d%%", p); setStatus(b); }
        }
        vTaskDelay(pdMS_TO_TICKS(10));
    }

    if (!esp_https_ota_is_complete_data_received(h)) {
        setStatus("OTA: truncated - aborted");
        esp_https_ota_abort(h);
        g_otaActive = false;
        return;
    }
    if (esp_https_ota_finish(h) != ESP_OK) {
        setStatus("OTA: finish failed");
        g_otaActive = false;        // a failed OTA must not leave the face permanently frozen
        return;
    }
    setStatus("OTA: ok - rebooting");
    mclog::tagInfo(kTag, "OTA complete, rebooting into the new slot");
    vTaskDelay(pdMS_TO_TICKS(400));
    esp_restart();
}

// Declare this image good, so the bootloader stops holding a rollback over it.
//
// WHAT COUNTS AS GOOD is the whole design question. Marking valid in app_main would make the
// rollback meaningless -- an image that panics two seconds later would still have declared itself
// healthy. So the criterion is evidence of actually working: the app task has been alive and
// animating for kHealthyMs, which is exactly what the freeze bugs in this project violated. An
// image that boots into a frozen face does NOT mark itself valid and is reverted.
//
// Deliberately NOT requiring the network: a build with no credentials, or one at a bench with no
// access point, is not a broken image and must not be rolled back for it.
constexpr uint32_t kHealthyMs = 12000;

void markValidTask(void*)
{
    vTaskDelay(pdMS_TO_TICKS(kHealthyMs));

#ifdef OPENDUBS_NO_MARK_VALID
    // The deliberately-bad image used to TEST rollback. It boots, runs, and never declares itself
    // good -- so the next reboot must revert to the previous slot. If it does not, rollback is not
    // working and we would only have found out on the robot.
    mclog::tagError(kTag, "OPENDUBS_NO_MARK_VALID: refusing to mark valid (rollback test image)");
    setStatus("ROLLBACK TEST: not marking valid");
#else
    const esp_partition_t* run = esp_ota_get_running_partition();
    esp_ota_img_states_t   st  = ESP_OTA_IMG_UNDEFINED;
    if (run && esp_ota_get_state_partition(run, &st) == ESP_OK && st == ESP_OTA_IMG_PENDING_VERIFY) {
        if (esp_ota_mark_app_valid_cancel_rollback() == ESP_OK)
            mclog::tagInfo(kTag, "image marked valid after {} ms healthy on slot {}",
                           (int)kHealthyMs, run->label);
        else
            mclog::tagError(kTag, "mark_app_valid FAILED -- this image will roll back");
    }
#endif
    vTaskDelete(nullptr);
}

// ---- the platform half of the shared parser (net_cmd.h) ----
//
// OTA AND REBOOT ARE DEFERRED, and that is a fix rather than a consequence of the refactor. The old
// code sent "OK ota" and then called doOta() on this same task, which blocks for the whole ~60 s
// transfer -- so the command socket stopped answering mid-update, and "has it finished?" became
// unanswerable at exactly the moment someone wants to know. It cost a round of false diagnosis
// yesterday. Running the transfer on its own task keeps PING alive throughout. REBOOT had a
// smaller version of the same bug: esp_restart() ran so soon after sendto() that the ack could be
// dropped on the way out.
char     g_otaUrl[256] = "";
uint32_t g_rebootAt    = 0;

void otaTask(void*)
{
    doOta(g_otaUrl);
    vTaskDelete(nullptr);
}

void rebootTask(void*)
{
    vTaskDelay(pdMS_TO_TICKS(250));     // long enough for the ack to leave
    esp_restart();
}

}  // namespace

int netPlatPing(char* out, size_t cap)
{
    const esp_app_desc_t*  d   = esp_app_get_description();
    const esp_partition_t* run = esp_ota_get_running_partition();

    // IDENTIFY THE IMAGE BY ITS ELF HASH, not by a build timestamp: esp_app_desc.c is not
    // recompiled on every build, so its __DATE__/__TIME__ go stale and a flash that DID land looks
    // like one that did not.
    char sha[17] = "?";
    if (d) for (int i = 0; i < 8; ++i) snprintf(sha + i * 2, 3, "%02x", d->app_elf_sha256[i]);

    // PENDING_VERIFY vs VALID is the whole question when a rollback does not fire; "which slot" was
    // not enough and guessing at it cost a test cycle.
    esp_ota_img_states_t st = ESP_OTA_IMG_UNDEFINED;
    const char* sn = "?";
    if (run && esp_ota_get_state_partition(run, &st) == ESP_OK) {
        switch (st) {
            case ESP_OTA_IMG_NEW:            sn = "NEW";            break;
            case ESP_OTA_IMG_PENDING_VERIFY: sn = "PENDING_VERIFY"; break;
            case ESP_OTA_IMG_VALID:          sn = "VALID";          break;
            case ESP_OTA_IMG_INVALID:        sn = "INVALID";        break;
            case ESP_OTA_IMG_ABORTED:        sn = "ABORTED";        break;
            default:                         sn = "UNDEFINED";      break;
        }
    }

    // Where a lift or e-stop request would go, and how we know it. "none" means those controls have
    // nowhere to send to -- the one thing a PING should never leave implicit.
    char plc[40];
    const uint32_t pip = g_plcIp;
    if (pip == 0) snprintf(plc, sizeof(plc), "none");
    else snprintf(plc, sizeof(plc), "%u.%u.%u.%u/%s",
                  (unsigned)(pip & 0xff), (unsigned)((pip >> 8) & 0xff),
                  (unsigned)((pip >> 16) & 0xff), (unsigned)((pip >> 24) & 0xff),
                  g_plcByName ? "name" : "heard");

    return snprintf(out, cap, "slot=%s state=%s sha=%s | plc=%s | tp polls=%lu presses=%lu "
                              "errs=%lu last=%lu,%lu",
                    run ? run->label : "?", sn, sha, plc,
                    (unsigned long)od_tp_polls, (unsigned long)od_tp_presses,
                    (unsigned long)od_tp_errs, (unsigned long)od_tp_lastx,
                    (unsigned long)od_tp_lasty);
}

bool netPlatOta(const char* url)
{
    if (g_otaActive) return false;          // one at a time; the reply says so honestly
    snprintf(g_otaUrl, sizeof(g_otaUrl), "%.255s", url);
    return xTaskCreatePinnedToCore(otaTask, "ota", 8192, nullptr, 2, nullptr, 1) == pdPASS;
}

bool netPlatReboot()
{
    if (g_rebootAt != 0) return true;       // already scheduled
    g_rebootAt = 1;
    return xTaskCreatePinnedToCore(rebootTask, "reboot", 3072, nullptr, 2, nullptr, 1) == pdPASS;
}

const char* netPlatI2cScan() { return pantiltI2cScan(); }

const char* netPlatTof()
{
    static char tb[256];
    float mm = 0.0f;
    const bool got = tofReadMm(&mm);
    snprintf(tb, sizeof(tb), "%s | sample=%s%.0f | %s",
             tofStatus(), got ? "" : "none ", got ? mm : 0.0f, tofRegs());
    return tb;
}

bool netPlatRcFrame(const char* rx, int n)
{
    // CAN_ID_PAN_TILT_RATE from the StamPLC, which addresses the head DIRECTLY rather than via the
    // Thor -- so the sticks keep aiming the head even if the dashboard stops. Layout is
    // rc_serial_probe/src/main.cpp verbatim: packed { u32 id; u8 dlc; u8 d[8] }, int16 LE pan deg/s
    // at d[0], tilt at d[2], full stick = 60 deg/s, sent at 20 Hz.
    //
    // A RATE, NOT AN ANGLE, and that is load-bearing: the stick is spring-centred and the HEAD owns
    // the position, so two devices can never integrate separately and diverge.
    if (n != 13) return false;
    const uint32_t id = (uint32_t)(rx[0] | (rx[1] << 8) | (rx[2] << 16) | ((uint32_t)rx[3] << 24));
    if (id != 0x107u || (uint8_t)rx[4] != 4) return false;
    int16_t pan = 0, tilt = 0;
    memcpy(&pan,  rx + 5, 2);
    memcpy(&tilt, rx + 7, 2);
    pantiltRcRate((float)pan, (float)tilt);
    return true;
}

namespace {

void cmdTask(void*)
{
    const int sock = socket(AF_INET, SOCK_DGRAM, IPPROTO_IP);
    if (sock < 0) { mclog::tagError(kTag, "socket() failed"); vTaskDelete(nullptr); return; }

    sockaddr_in me = {};
    me.sin_family      = AF_INET;
    me.sin_addr.s_addr = htonl(INADDR_ANY);
    me.sin_port        = htons(kCmdPort);
    if (bind(sock, (sockaddr*)&me, sizeof(me)) < 0) {
        mclog::tagError(kTag, "bind({}) failed", kCmdPort);
        close(sock);
        vTaskDelete(nullptr);
        return;
    }
    mclog::tagInfo(kTag, "command listener on udp/{}", kCmdPort);

    // A receive timeout turns the blocking listener into a 20 Hz tick, which is what publishes the
    // lift intent. One socket, one task: no second timer to keep in step with this one.
    timeval rcvTo = {};
    rcvTo.tv_usec = kPubMs * 1000;
    setsockopt(sock, SOL_SOCKET, SO_RCVTIMEO, &rcvTo, sizeof(rcvTo));
    uint32_t lastPub = 0;

    char        rx[256];
    sockaddr_in from;
    socklen_t   fromLen;

    for (;;) {
        fromLen = sizeof(from);
        int n = recvfrom(sock, rx, sizeof(rx) - 1, 0, (sockaddr*)&from, &fromLen);

        // --- outbound, every kPubMs regardless of whether a packet arrived ---
        const uint32_t nowMs = (uint32_t)(esp_timer_get_time() / 1000);
        if (nowMs - lastPub >= kPubMs && g_plcIp != 0) {
            lastPub = nowMs;
            sockaddr_in plc = {};
            plc.sin_family      = AF_INET;
            plc.sin_addr.s_addr = g_plcIp;
            plc.sin_port        = htons(kPlcCmdPort);

            // The lift is HOLD-TO-MOVE and heartbeat-gated at the far end, so a dropped packet
            // costs 50 ms of travel and a dead head stops the lift within 250 ms by construction.
            // We keep asserting for kLiftHoldMs after release so the STOP is sent several times,
            // then go quiet rather than hold the StamPLC's remote channel open forever.
            const bool liftFresh = (g_liftMs != 0) && (nowMs - g_liftMs) < kLiftHoldMs;
            if (liftFresh) {
                char tx[32];
                const int m = snprintf(tx, sizeof(tx), "MAST CMD %.2f\n", g_liftReq);
                sendto(sock, tx, m, 0, (sockaddr*)&plc, sizeof(plc));
            }

            // STOPPING IS NEVER CONFIRMED and is resent until the robot reports E_STOP -- this is
            // the one message where a lost packet matters.
            if (g_estopReq) {
                const char* tx = "ESTOP\n";
                sendto(sock, tx, 6, 0, (sockaddr*)&plc, sizeof(plc));
                const char* sn = nullptr;
                if (linkState(&sn, nullptr) && strcmp(sn, "E_STOP") == 0) g_estopReq = false;
            }
        }

        if (n <= 0) continue;
        rx[n] = 0;
        while (n > 0 && (rx[n - 1] == '\n' || rx[n - 1] == '\r')) rx[--n] = 0;

        // ONE PARSER, SHARED WITH THE TWIN. See net_cmd.cpp: a second copy would diverge, and a
        // twin that answers slightly differently from the head is worse than no twin. This task now
        // owns only the TRANSPORT -- receive, hand the line over, send whatever comes back.
        char txb[384];
        const int m = netHandleLine(rx, n, txb, sizeof(txb));
        if (m > 0) sendto(sock, txb, m, 0, (sockaddr*)&from, fromLen);
    }
}

}  // namespace

const char* netStatus() { return g_status; }


bool        netReady()  { return g_ready; }
bool        netOtaActive() { return g_otaActive; }

void netLiftRequest(float v)
{
    g_liftReq = v;
    g_liftMs  = (uint32_t)(esp_timer_get_time() / 1000);
}

void netEstopRequest()
{
    g_estopReq = true;
    netLiftRequest(0.0f);     // whatever else happens, stop asking the lift to move
}

bool netCommandLink(unsigned* ageMsOut)
{
    if (g_plcIp == 0) return false;
    if (ageMsOut) *ageMsOut = (unsigned)((uint32_t)(esp_timer_get_time() / 1000) - g_plcStamp);
    return true;
}
bool netEstopPending() { return g_estopReq; }

bool netLiftAllowed(const char** whyOut)
{
    // Stale telemetry is not permission. If the StamPLC has gone quiet we do not know the gate, and
    // the honest answer is no.
    if (g_liftGateStamp == 0 || (perceptNowMs() - g_liftGateStamp) > 3000) {
        if (whyOut) *whyOut = "no link to the robot";
        return false;
    }
    if (whyOut) *whyOut = g_liftWhy;
    return g_liftWhy == nullptr;
}

void netStart()
{
    // Independent of Wi-Fi: health is about the app, not the link.
    xTaskCreatePinnedToCore(markValidTask, "markok", 3072, nullptr, 1, nullptr, 1);

    // Priority 2 PINNED CPU1. `main`, which animates the face, is pinned CPU0 at priority 1 --
    // pinning away from CPU0 is what protects the animation, not the priority number. Association
    // is bursty and event-driven, so this task exits once started and costs nothing steady-state.
    xTaskCreatePinnedToCore(task, "net", 4096, nullptr, 2, nullptr, 1);
}

#else   // !ESP_PLATFORM -- desktop SDL build

// THE TWIN LISTENS. Wi-Fi, OTA, mDNS and the StamPLC link stay stubbed -- the only thing the
// desktop build grows here is a COMMAND TRANSPORT, so the same lines that drive the head drive the
// twin, through the same parser (net_cmd.cpp).
//
// BOUND TO LOOPBACK ONLY, and that is not a default to be relaxed casually: this listener accepts
// unauthenticated commands that move a face, select a theme and play sounds, and the head's own
// protection today is that you must be on the robot's network to reach it. A twin on a laptop has
// no such boundary, so it refuses to have one opened for it. 127.0.0.1 is the whole access control.
#include <atomic>
#include <cstring>
#include <thread>
#include <arpa/inet.h>
#include <netinet/in.h>
#include <sys/socket.h>
#include <unistd.h>

#include "net_cmd.h"

namespace {
std::atomic<bool> g_twinUp{false};
char g_twinStatus[64] = "twin: command listener not started";

void twinCmdThread()
{
    const int sock = socket(AF_INET, SOCK_DGRAM, 0);
    if (sock < 0) { snprintf(g_twinStatus, sizeof(g_twinStatus), "twin: socket() failed"); return; }

    sockaddr_in me{};
    me.sin_family      = AF_INET;
    me.sin_addr.s_addr = htonl(INADDR_LOOPBACK);     // NOT INADDR_ANY -- see above
    me.sin_port        = htons(4242);
    if (bind(sock, (sockaddr*)&me, sizeof(me)) < 0) {
        // Most likely another twin already has it. Say so instead of dying silently, because a
        // twin that is not listening looks exactly like a bridge that is not sending.
        snprintf(g_twinStatus, sizeof(g_twinStatus), "twin: bind 127.0.0.1:4242 failed (in use?)");
        close(sock);
        return;
    }
    g_twinUp = true;
    snprintf(g_twinStatus, sizeof(g_twinStatus), "twin: listening on 127.0.0.1:4242");

    char rx[512], tx[384];
    for (;;) {
        sockaddr_in from{};
        socklen_t   fl = sizeof(from);
        const int   n  = (int)recvfrom(sock, rx, sizeof(rx) - 1, 0, (sockaddr*)&from, &fl);
        if (n <= 0) continue;
        int len = n;
        rx[len] = 0;
        while (len > 0 && (rx[len - 1] == '\n' || rx[len - 1] == '\r')) rx[--len] = 0;
        const int m = netHandleLine(rx, len, tx, sizeof(tx));
        if (m > 0) sendto(sock, tx, m, 0, (sockaddr*)&from, fl);
    }
}
}  // namespace

void netStart()
{
    // Detached: the twin has no orderly shutdown and the process exit takes it with it.
    std::thread(twinCmdThread).detach();
}

const char* netStatus() { return g_twinStatus; }
bool netReady() { return g_twinUp; }
bool netOtaActive() { return false; }
void netLiftRequest(float)        {}
void netEstopRequest()            {}
bool netCommandLink(unsigned*)    { return false; }
bool netEstopPending()            { return false; }
bool netLiftAllowed(const char** w) { if (w) *w = "no robot on the desktop build"; return false; }

// linkState() is NOT stubbed any more -- it lives in net_cmd.cpp and reads the state that
// `STATE <NAME>` writes. That is what makes the twin's face follow a state line exactly as the
// head's does, which is the entire point of having a twin. Until a STATE arrives it still reports
// false, so the twin starts on the real no-link face.

// ---- platform hooks: what a twin cannot honestly answer ----
int netPlatPing(char* out, size_t cap)
{
    return snprintf(out, cap, "slot=twin state=n/a sha=desktop | plc=none");
}
// NEVER a silent success. A twin that accepted OTA or REBOOT and did nothing would be the worst
// possible answer, because the caller would believe the head had taken it.
bool        netPlatOta(const char*)        { return false; }
bool        netPlatReboot()                { return false; }
const char* netPlatI2cScan()               { return "i2c scan: no bus on the twin"; }
const char* netPlatTof()                   { return "tof: no sensor on the twin"; }
bool        netPlatRcFrame(const char*, int) { return false; }

#endif  // ESP_PLATFORM
