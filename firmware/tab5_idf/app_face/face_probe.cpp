#include "face_probe.h"

// Generated by build.sh; defines OPENDUBS_PROBE_FACEDET only when the probe is requested.
#include "face_probe_config.h"

#ifndef OPENDUBS_PROBE_FACEDET

// Deliberately empty -- see face_probe.h. esp-dl is never referenced from here, so the linker
// drops it and the image is byte-identical to a build without the dependency (measured).
void faceProbeStart() {}
bool faceTrackGet(float*, float*, uint32_t*) { return false; }
const char* faceProbeStatus() { return "probe: off"; }

#else

#include <esp_heap_caps.h>
#include <esp_timer.h>
#include <freertos/FreeRTOS.h>
#include <freertos/task.h>
#include <mooncake_log.h>
#include <hal/hal.h>
#include <lvgl.h>
#include <atomic>
#include <cstring>
#include <cstdio>

#include "dl_image.hpp"
#include "human_face_detect.hpp"

// Generated at build time by build.sh from probe/human_face.jpg, so it cannot drift from the
// committed fixture the way a checked-in generated file would. See build.sh sync_sources().
#include "face_probe_image.h"

namespace {

constexpr const char* kTag = "faceprobe";

// ON-PANEL STATUS. CLAUDE.md warns against a bench that reports ONLY on the panel, because
// usually nobody is there. Today the inverse failed just as badly: a probe reporting only over a
// serial port I could not reliably read left someone standing at the device with no way to tell
// whether it worked. So report BOTH. The face app draws this string.
// Wrap-safe deadline test -- AUDIT.md invariant 5. Third copy in this directory after
// app_face.cpp and cues.cpp, which is one too many: a fourth should become a shared header.
inline bool due(uint32_t now, uint32_t at) { return (int32_t)(now - at) >= 0; }

char g_status[72] = "probe: starting";
void setStatus(const char* s)
{
    strncpy(g_status, s, sizeof(g_status) - 1);
    g_status[sizeof(g_status) - 1] = 0;
}

// The reference image ships with esp-dl's own human_face_detect example, so it is the input the
// model was demonstrated against -- which is what makes a miss meaningful rather than arguable.
// 320x240. Expect exactly one face, roughly centred.
constexpr int kExpectFaces = 1;

// Enough passes to separate first-run cost (model load, PSRAM allocation, cache cold) from the
// steady state. The first number is the one that matters for a one-shot glance at a bystander;
// the steady state is the one that matters for tracking.
constexpr int kPasses = 8;

void report(HumanFaceDetect* det)
{
    // Decode once, outside the timed loop: we are measuring INFERENCE, and folding a software JPEG
    // decode into that number would quietly make the model look several times slower than it is.
    // (The P4 has a hardware JPEG codec. This probe does not use it -- the decode is not what is
    // being measured, and reaching for the accelerator here would add a variable, not remove one.)
    auto img = dl::image::sw_decode_jpeg(
        {(uint8_t*)kFaceProbeJpeg, sizeof(kFaceProbeJpeg)},
        dl::image::DL_IMAGE_PIX_TYPE_RGB888);

    if (!img.data) {
        mclog::tagError(kTag, "INCONCLUSIVE: jpeg decode failed -- the probe is broken, not the model");
        return;
    }
    mclog::tagInfo(kTag, "decoded {}x{} rgb888", img.width, img.height);

    int64_t first = 0, total = 0;
    size_t  faces = 0;

    for (int i = 0; i < kPasses; ++i) {
        const int64_t t0 = esp_timer_get_time();
        auto& results    = det->run(img);
        const int64_t dt = esp_timer_get_time() - t0;

        if (i == 0) {
            first = dt;
            faces = results.size();
            // Print the boxes once. A count alone cannot distinguish "found the face" from "found
            // a false positive somewhere else", and that distinction is the whole point of using a
            // reference image with a known answer.
            for (const auto& r : results) {
                mclog::tagInfo(kTag, "  face score={:.3f} box=({},{})-({},{})",
                               r.score, r.box[0], r.box[1], r.box[2], r.box[3]);
            }
        } else {
            total += dt;
        }
        vTaskDelay(pdMS_TO_TICKS(5));   // yield; this task must never starve the LVGL task
    }

    const float firstMs  = first / 1000.0f;
    const float steadyMs = (kPasses > 1) ? (total / (float)(kPasses - 1)) / 1000.0f : firstMs;

    mclog::tagInfo(kTag, "first={:.1f}ms steady={:.1f}ms ({:.1f} fps) faces={} expect={}",
                   firstMs, steadyMs, steadyMs > 0 ? 1000.0f / steadyMs : 0.0f,
                   (int)faces, kExpectFaces);
    mclog::tagInfo(kTag, "psram free={}K largest={}K",
                   heap_caps_get_free_size(MALLOC_CAP_SPIRAM) / 1024,
                   heap_caps_get_largest_free_block(MALLOC_CAP_SPIRAM) / 1024);

    // State the verdict. Do not make the reader infer it from numbers, and do not blame the
    // hardware for a result the probe cannot distinguish.
    if (faces == kExpectFaces) {
        mclog::tagInfo(kTag, "VERDICT: PASS -- detector works, {:.1f}ms per frame steady", steadyMs);
        { char b[72]; snprintf(b, sizeof(b), "selftest PASS %.0fms - starting camera", steadyMs);
          setStatus(b); }
    } else if (faces == 0) {
        mclog::tagError(kTag, "VERDICT: FAIL -- no face in an image that contains one");
        setStatus("selftest FAIL - no face in reference image");
    } else {
        mclog::tagError(kTag, "VERDICT: FAIL -- {} faces in an image containing {}",
                        (int)faces, kExpectFaces);
    }

    heap_caps_free(img.data);
}

// ------------------------------------------------------------------------------------------
// STAGE 2: live tracking off the camera. Stage 1 proves the MODEL; only this proves the CAMERA.
//
// Published as plain atomics, read by the face app's own render loop. The tracker NEVER touches
// LVGL -- an unlocked LVGL call from a second task corrupts internal state rather than failing
// cleanly, and that was the longest-running freeze in this app. AUDIT.md invariant 1, satisfied
// structurally instead of by vigilance.
// ------------------------------------------------------------------------------------------
std::atomic<float>    g_trackX{0.0f};
std::atomic<float>    g_trackY{0.0f};
std::atomic<uint32_t> g_trackSeq{0};
std::atomic<uint32_t> g_trackStamp{0};

// How long a fix stays good after the face leaves: long enough to ride out a dropped frame,
// short enough that the eyes do not stare at nobody.
constexpr uint32_t kHoldMs = 900;

// Camera canvas geometry, read from hal_camera.cpp rather than assumed --
//   lv_canvas_set_buffer(camera_canvas, img_show->data, CAMERA_WIDTH, CAMERA_HEIGHT, RGB565)
// with CAMERA_WIDTH 1280, CAMERA_HEIGHT 720. img_show is separately allocated 720x1280, and
// guessing between the two would skew every coordinate.
constexpr int kCamW = 1280;
constexpr int kCamH = 720;

// Orientation. SETTLED BY WATCHING THE RETICLE, which is why the reticle exists -- it tracked
// backwards, and that is the whole evidence needed.
//
// The reasoning, now that it can be checked rather than argued: the PPA already applies
// mirror_x = true, which flips the camera's view into a MIRROR image. So in the frame we read,
// a person moving to their own right moves toward larger x -- which is exactly the direction the
// gaze wants, since the eyes should look toward the side of the panel the person is on. Applying
// our own flip on top of the hardware's made two mirrors, which cancel into backwards.
//
// So kMirrorX is FALSE: the hardware did the mirroring, and we must not repeat it. kMirrorY stays
// false because the PPA does not flip Y (mirror_y = false) and nothing else inverts it.
constexpr bool kMirrorX = false;
constexpr bool kMirrorY = false;

// The detection marker, drawn ON the preview as a child of it, in preview pixel coordinates.
// A child, so it cannot drift relative to the image and needs no coordinate translation; hollow,
// so it never hides what it is marking. Created once, then only moved or hidden -- steady-state
// allocation is AUDIT.md invariant 6. Called with the LVGL lock already held.
lv_obj_t* g_mark = nullptr;
lv_obj_t* g_diag = nullptr;

// What state is the task that runs onRunning actually in? onRunning lives in ESP-IDF's "main"
// task (app_main's `while (!app::IsDone())` loop), so FreeRTOS can be asked directly instead of
// guessed at. eBlocked with a healthy stack means it is waiting on something -- most likely the
// LVGL mutex. A tiny high-water mark means it overflowed its stack. eDeleted means it is gone.
const char* taskStateName(eTaskState s)
{
    switch (s) {
        case eRunning:   return "RUN";
        case eReady:     return "READY";
        case eBlocked:   return "BLOCKED";
        case eSuspended: return "SUSP";
        case eDeleted:   return "DELETED";
        default:         return "INVALID";
    }
}
void faceReticleAt(int x, int y, lv_obj_t* parent)
{
    if (!g_mark) {
        g_mark = lv_obj_create(parent);
        lv_obj_remove_style_all(g_mark);
        lv_obj_set_size(g_mark, 44, 44);
        lv_obj_set_style_bg_opa(g_mark, LV_OPA_TRANSP, 0);
        lv_obj_set_style_border_width(g_mark, 3, 0);
        lv_obj_set_style_border_color(g_mark, lv_color_hex(0x00ff66), 0);
        lv_obj_add_flag(g_mark, LV_OBJ_FLAG_HIDDEN);
    }
    if (x < 0) {
        lv_obj_add_flag(g_mark, LV_OBJ_FLAG_HIDDEN);
        return;
    }
    lv_obj_remove_flag(g_mark, LV_OBJ_FLAG_HIDDEN);
    lv_obj_set_pos(g_mark, x - 22, y - 22);
}

// Preview size. ONE software downscale produces both the picture shown on the panel and the
// picture handed to the detector, from the same pass over the same source pixels. That identity is
// the whole point: if the preview looks like a room, the conversion is right; if the preview looks
// like a sheared mess, the conversion is wrong -- and either way the detector saw exactly what you
// are looking at. No inference.
// MATCH THE MODEL, not the camera. Read from human_face_detect's README and its anchor config:
// the MSR first stage takes 120*160*3 -- a 4:3 input -- and its anchors are 16/32/64/128 px IN
// THAT SPACE. Two consequences, and both were hurting us:
//
//   ASPECT: feeding 320x180 (16:9) meant the preprocessor resized x and y independently
//   (get_resize_scale_x / _y are separate) down to 160x120, arriving horizontally squashed.
//   The reference image that scores 0.835 is 320x240 -- 4:3.
//
//   SIZE: a person ~200 px wide in a 1280 frame becomes ~25 px in a 160-wide model input, UNDER
//   the 32 px anchor. That is precisely the reported symptom: it only fires when the face fills
//   most of the frame.
//
// So crop the centre 960x720 of the 1280x720 frame -- which IS 4:3, costs no vertical field of
// view, and trims only the outer edges -- and scale it to 320x240, the exact geometry the
// self-test passes on. The same person now lands at ~33 px in model space, on the 32 px anchor.
constexpr int kDetW = 320, kDetH = 240;        // 4:3, matching the model's native input
constexpr int kCropW = 960, kCropH = 720;      // 4:3 centre crop of the 1280x720 frame
constexpr int kCropX = (kCamW - kCropW) / 2;   // 160

void trackLoop(HumanFaceDetect* det)
{
    // Two buffers, allocated once. RGB565 for the panel (the canvas format), RGB888 for the model
    // (the only format this model is proven on -- the self-test decodes its JPEG to RGB888).
    uint16_t* prev565 = (uint16_t*)heap_caps_malloc(kDetW * kDetH * 2, MALLOC_CAP_SPIRAM);
    uint8_t*  rgb888  = (uint8_t*)heap_caps_malloc(kDetW * kDetH * 3, MALLOC_CAP_SPIRAM);
    if (!prev565 || !rgb888) { setStatus("probe: no PSRAM for preview"); return; }
    memset(prev565, 0, kDetW * kDetH * 2);

    GetHAL()->lvglLock();
    // The HAL hands over frames by pointing a canvas at the PPA output. This one stays hidden --
    // it is 1280x720 and would cover the face. We only want its buffer pointer.
    lv_obj_t* cam = lv_canvas_create(lv_screen_active());
    lv_obj_add_flag(cam, LV_OBJ_FLAG_HIDDEN);

    // The VISIBLE preview: a 320x180 canvas pointed at our own downscaled buffer. No LVGL scaling
    // anywhere, so no layer allocation -- the scaling is the software pass we already do. Bottom
    // left, out of the eyes' way.
    lv_obj_t* prev = lv_canvas_create(lv_screen_active());
    lv_canvas_set_buffer(prev, prev565, kDetW, kDetH, LV_COLOR_FORMAT_RGB565);
    lv_obj_align(prev, LV_ALIGN_BOTTOM_LEFT, 8, -8);
    lv_obj_move_foreground(prev);
    GetHAL()->lvglUnlock();

    // A SECOND status line, painted by THIS task rather than by onRunning. Emma's observation
    // localises the fault precisely: the camera feed and LVGL's FPS counter are live while the
    // animation AND the counter are frozen -- and both of those are driven by onRunning. So the
    // app task is stuck and the probe task is not. Reporting through onRunning therefore cannot
    // tell us anything about onRunning. This line bypasses it, and having the two side by side
    // makes the fault location visible: yellow (onRunning) frozen, cyan (probe) still counting.
    GetHAL()->lvglLock();
    g_diag = lv_label_create(lv_screen_active());
    lv_obj_set_style_text_color(g_diag, lv_color_hex(0x00e5ff), LV_PART_MAIN);
    lv_obj_align(g_diag, LV_ALIGN_TOP_MID, 0, 86);
    lv_label_set_text(g_diag, "probe label: live");
    GetHAL()->lvglUnlock();

    GetHAL()->startCameraCapture(cam);
    setStatus("camera on - waiting for first frame");
    mclog::tagInfo(kTag, "camera started; preview %dx%d bottom-left", kDetW, kDetH);

    // Grab the source pointer ONCE. hal_camera.cpp calls lv_canvas_set_buffer with the same
    // img_show->data every frame, so it never changes -- and caching it means the hot loop needs
    // no LVGL lock at all to read pixels.
    const uint16_t* src = nullptr;
    for (int i = 0; i < 100 && !src; ++i) {
        GetHAL()->lvglLock();
        src = (const uint16_t*)lv_canvas_get_buf(cam);
        GetHAL()->lvglUnlock();
        if (!src) vTaskDelay(pdMS_TO_TICKS(100));
    }
    if (!src) { setStatus("camera: NO FRAME BUFFER - capture never started"); return; }

    uint32_t frames = 0, hits = 0;
    int64_t  accum = 0;

    for (;;) {
        // 200 ms, not 60. Gaze does not need more: a saccade takes ~20-200 ms and the face holds
        // a fix for 900 ms, so detecting 5x a second is already faster than the eyes can act on.
        // 60 ms was three times the work for no behavioural gain, and duty cycle is what starved
        // the app task.
        vTaskDelay(pdMS_TO_TICKS(200));

        // ---- ONE PASS: downscale + convert. NO LVGL LOCK HELD. ----------------------------
        // Reading the camera buffer needs no lock: the camera task writes it via PPA without
        // holding the LVGL lock either, so the lock protects nothing here. Holding it only blocked
        // the render loop -- which is what froze the animation while LVGL's FPS counter kept
        // ticking. Tearing across a frame boundary is harmless for detection.
        uint32_t sum = 0, lo = 255, hi = 0;
        for (int y = 0; y < kDetH; ++y) {
            const uint16_t* srow = src + (size_t)(y * kCropH / kDetH) * kCamW + kCropX;
            uint16_t*       prow = prev565 + (size_t)y * kDetW;
            uint8_t*        drow = rgb888 + (size_t)y * kDetW * 3;
            for (int x = 0; x < kDetW; ++x) {
                const uint16_t p = srow[x * kCropW / kDetW];
                prow[x] = p;                                  // preview: straight copy
                const uint8_t r = (uint8_t)(((p >> 11) & 0x1f) << 3);
                const uint8_t g = (uint8_t)(((p >> 5) & 0x3f) << 2);
                const uint8_t b = (uint8_t)((p & 0x1f) << 3);
                drow[x * 3 + 0] = r;
                drow[x * 3 + 1] = g;
                drow[x * 3 + 2] = b;
                const uint8_t l = (uint8_t)((r + g + b) / 3);
                sum += l; if (l < lo) lo = l; if (l > hi) hi = l;
            }
        }
        const uint32_t avg = sum / (kDetW * kDetH);

        dl::image::img_t frame = {};
        frame.data     = rgb888;
        frame.width    = kDetW;
        frame.height   = kDetH;
        frame.pix_type = dl::image::DL_IMAGE_PIX_TYPE_RGB888;

        const int64_t t0 = esp_timer_get_time();
        auto& res        = det->run(frame);
        accum += esp_timer_get_time() - t0;
        frames++;

        const uint32_t now = (uint32_t)GetHAL()->millis();
        int rx = -1, ry = -1;

        if (!res.empty()) {
            const dl::detect::result_t* best = nullptr;
            int bestArea = -1;
            for (const auto& r : res) {
                const int a = (r.box[2] - r.box[0]) * (r.box[3] - r.box[1]);
                if (a > bestArea) { bestArea = a; best = &r; }
            }
            const float cx = (best->box[0] + best->box[2]) * 0.5f;
            const float cy = (best->box[1] + best->box[3]) * 0.5f;

            // Reticle position in PREVIEW pixels -- drawn over the very image it was found in, so
            // a correct detection is unmistakable and a wrong one is obvious.
            rx = (int)cx;
            ry = (int)cy;

            float nx = (cx / (float)kDetW) * 2.0f - 1.0f;
            float ny = (cy / (float)kDetH) * 2.0f - 1.0f;
            if (kMirrorX) nx = -nx;
            if (kMirrorY) ny = -ny;
            nx = nx < -1.0f ? -1.0f : (nx > 1.0f ? 1.0f : nx);
            // Match the face's own narrower vertical range (newSaccade uses amp * 0.55).
            ny = (ny < -1.0f ? -1.0f : (ny > 1.0f ? 1.0f : ny)) * 0.55f;

            g_trackX.store(nx);
            g_trackY.store(ny);
            g_trackStamp.store(now);
            g_trackSeq.fetch_add(1);
            hits++;

            char b[72];
            snprintf(b, sizeof(b), "#%lu FACE %.2f  gaze %+.2f,%+.2f  %.0fms",
                     (unsigned long)frames, best->score, nx, ny, accum / 1000.0f / frames);
            setStatus(b);
            if ((hits % 8) == 1) {
                mclog::tagInfo(kTag, "TRACK {:.2f} box=({},{})-({},{}) gaze={:.2f},{:.2f}",
                               best->score, best->box[0], best->box[1], best->box[2], best->box[3],
                               nx, ny);
            }
        } else {
            // Report the EXPOSURE, not just "no face". lo/hi/avg says whether the preview is a
            // real picture, a black frame (lens covered, capture dead) or a white-out -- which is
            // the difference between "my code is wrong" and "the camera cannot see anything".
            char b[72];
            snprintf(b, sizeof(b), "#%lu no face  luma %lu/%lu/%lu  %.0fms",
                     (unsigned long)frames, (unsigned long)lo, (unsigned long)avg,
                     (unsigned long)hi, accum / 1000.0f / frames);
            setStatus(b);
            if (g_trackStamp.load() != 0 && due(now, g_trackStamp.load() + kHoldMs)) {
                g_trackStamp.store(0);
            }
        }

        // Only now take the lock, and only to repaint the preview and move the reticle.
        // Diagnose the app task, then paint both the preview and the diagnosis in one locked
        // section. uxTaskGetStackHighWaterMark reports the MINIMUM free stack ever seen, in words.
        char diag[80];
        TaskHandle_t mainTask = xTaskGetHandle("main");
        if (mainTask) {
            snprintf(diag, sizeof(diag), "#%lu main=%s stack=%luw  probe alive",
                     (unsigned long)frames, taskStateName(eTaskGetState(mainTask)),
                     (unsigned long)uxTaskGetStackHighWaterMark(mainTask));
        } else {
            snprintf(diag, sizeof(diag), "#%lu main task NOT FOUND", (unsigned long)frames);
        }

        GetHAL()->lvglLock();
        lv_obj_invalidate(prev);
        faceReticleAt(rx, ry, prev);
        if (g_diag) lv_label_set_text(g_diag, diag);
        GetHAL()->lvglUnlock();
    }
}

void task(void*)
{
    // Let the face app build its scene first: this allocates several MB of PSRAM for the model and
    // must not race the eye's own startup allocation.
    vTaskDelay(pdMS_TO_TICKS(4000));

    setStatus("probe: loading model");
    mclog::tagInfo(kTag, "constructing HumanFaceDetect (model load)");
    const int64_t t0  = esp_timer_get_time();
    auto*         det = new HumanFaceDetect();
    mclog::tagInfo(kTag, "model loaded in {:.0f}ms", (esp_timer_get_time() - t0) / 1000.0f);

    // STAGE 1: the reference image, once. If this fails, nothing about the camera matters yet, and
    // the log says which half is broken.
    report(det);

    // STAGE 2: live, same model instance -- a second would cost another copy of the weights.
    trackLoop(det);
}

}  // namespace

const char* faceProbeStatus() { return g_status; }

bool faceTrackGet(float* nx, float* ny, uint32_t* seq)
{
    const uint32_t stamp = g_trackStamp.load();
    if (stamp == 0) return false;
    // Wrap-safe, same reasoning as due(): subtract first, then sign. This is the public entry
    // point and sits outside the anonymous namespace, so it cannot see that helper.
    const uint32_t now = (uint32_t)GetHAL()->millis();
    if ((int32_t)(now - (stamp + kHoldMs)) < 0) {
        *nx  = g_trackX.load();
        *ny  = g_trackY.load();
        *seq = g_trackSeq.load();
        return true;
    }
    return false;
}

void faceProbeStart()
{
    // A PLAIN task. This previously allocated its own TCB and stack with MALLOC_CAP_DMA, which was
    // a workaround for exactly one thing: the IDF 5.4.2 allocator handing out TCM for task memory,
    // which FreeRTOS then rejected. IDF 5.5.5 drops TCM from the heap, so the workaround is not
    // merely unnecessary -- it is HARMFUL. Asking for ~24 KB of contiguous DMA-capable internal
    // memory can simply fail, and when it did, the probe logged a line nobody could read and
    // silently never started. That is precisely what happened.
    // PRIORITY 1, PINNED TO CORE 1. Measured, not guessed: with the probe at priority 2 and
    // UNPINNED, FreeRTOS scheduled it on CPU0 -- where the `main` task that runs onRunning is
    // pinned at priority 1 -- and preempted it. The probe's cycle is a 76,800-sample strided read
    // across a 1280-wide PSRAM buffer plus ~35 ms of inference, so main sat in eReady and the face
    // animation stopped while LVGL's own task kept rendering. That is exactly the reported
    // symptom: video live, FPS live, animation and the onRunning-painted counter frozen.
    //
    // Core 1 is where the vendor camera task already lives (priority 5, pinned), so perception
    // work is now confined to one core and CPU0 belongs to the face. Priority 1 means that even
    // if affinity were ever relaxed it would round-robin with main rather than starve it.
    //
    // THE RULE: a best-effort perception task must never outrank the task that animates the face.
    if (xTaskCreatePinnedToCore(task, "faceprobe", 6144, nullptr, 1, nullptr, 1) != pdPASS) {
        setStatus("probe: TASK CREATE FAILED");
        mclog::tagError(kTag, "task create failed");
    }
}

#endif  // OPENDUBS_PROBE_FACEDET
