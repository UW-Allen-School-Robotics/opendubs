#include "ui_settings.h"
#include "cues.h"
#include "touch_ui_config.h"

// touch_ui_config.h is GENERATED by build.sh. Fallbacks so the desktop target, which does not
// run the generator, still compiles -- and so a missing generator fails OPEN (UI present,
// instrument absent) rather than silently shipping the crosshair.
#ifndef OPENDUBS_TOUCH_UI
#define OPENDUBS_TOUCH_UI 1
#endif
#ifndef OPENDUBS_TOUCH_DEBUG
#define OPENDUBS_TOUCH_DEBUG 0
#endif

#if OPENDUBS_TOUCH_UI

#include <hal/hal.h>
#include <lvgl.h>
#include <mooncake_log.h>
#ifdef ESP_PLATFORM
#include <nvs.h>
#include <nvs_flash.h>
#endif
#include <smooth_lvgl.h>
#include <algorithm>
#include <memory>
#include <cstdio>

using namespace smooth_ui_toolkit;
using namespace smooth_ui_toolkit::lvgl_cpp;

namespace {

constexpr const char* kTag = "settings";
constexpr const char* kNs  = "face";          // NVS namespace

bool g_open      = false;
bool g_audio     = false;                      // default OFF: the Mode tone was rejected as too
                                               // loud, and shipping it on would re-make that call
                                               // for the operator. Opt-in, not opt-out.
bool g_telemetry = false;
// The tracking reticle. DEFAULT OFF: on a robot it is a box chasing people across the face, which
// reads as surveillance rather than attention. It is a developer instrument for confirming that
// the gaze mapping is right, so it is opt-in like the rest of them.
bool g_reticle   = false;

lv_obj_t* g_root = nullptr;                    // the panel; hidden unless open

std::unique_ptr<Container> g_close;
std::unique_ptr<Switch>    g_swAudio;
std::unique_ptr<Switch>    g_swTelem;
std::unique_ptr<Switch>    g_swRetic;
std::unique_ptr<Slider>    g_slVol;
std::unique_ptr<Label>     g_lblVol;

// ---- persistence ---------------------------------------------------------------------------
// NVS, so a setting survives a reboot. A volume someone set at the robot and lost on the next
// power cycle is worse than no control at all -- they would set it again, and stop trusting it.
#ifdef ESP_PLATFORM
// NVS MUST BE INITIALISED HERE, and that is a bug fix rather than belt-and-braces.
// settingsBuild() runs during scene build; net.cpp called nvs_flash_init() from the network task
// AFTER a 2500 ms delay. So every nvs_open() below ran against uninitialised NVS, failed, and
// returned early -- which is why a saved volume never came back after a reboot. The control
// worked and the persistence silently did not, which is the worst of the two failures.
// nvs_flash_init() is idempotent, so net.cpp's later call still succeeds.
//
// NOT erasing on NO_FREE_PAGES, matching net.cpp's policy deliberately: an erase here would
// destroy the stored Wi-Fi credentials and any per-robot values in the same partition.
bool nvsReady()
{
    static int state = -1;                       // -1 unknown, 0 unusable, 1 ready
    if (state >= 0) return state == 1;
    const esp_err_t r = nvs_flash_init();
    if (r == ESP_OK) { state = 1; return true; }
    mclog::tagError(kTag, "nvs_flash_init: {} -- settings will not persist, not erasing",
                    esp_err_to_name(r));
    state = 0;
    return false;
}

void load()
{
    if (!nvsReady()) return;
    nvs_handle_t h;
    if (nvs_open(kNs, NVS_READONLY, &h) != ESP_OK) return;
    uint8_t v = 0;
    if (nvs_get_u8(h, "audio", &v) == ESP_OK) g_audio = (v != 0);
    if (nvs_get_u8(h, "telem", &v) == ESP_OK) g_telemetry = (v != 0);
    if (nvs_get_u8(h, "retic", &v) == ESP_OK) g_reticle = (v != 0);
    if (nvs_get_u8(h, "vol", &v) == ESP_OK) GetHAL()->setSpeakerVolume(v);
    nvs_close(h);
    mclog::tagInfo(kTag, "loaded: audio={} telem={} vol={}", g_audio, g_telemetry,
                   GetHAL()->getSpeakerVolume());
}

void save()
{
    if (!nvsReady()) return;
    nvs_handle_t h;
    if (nvs_open(kNs, NVS_READWRITE, &h) != ESP_OK) {
        mclog::tagError(kTag, "nvs_open failed -- settings will not survive a reboot");
        return;
    }
    nvs_set_u8(h, "audio", g_audio ? 1 : 0);
    nvs_set_u8(h, "telem", g_telemetry ? 1 : 0);
    nvs_set_u8(h, "retic", g_reticle ? 1 : 0);
    nvs_set_u8(h, "vol", GetHAL()->getSpeakerVolume());
    nvs_commit(h);
    nvs_close(h);
}

#else   // desktop SDL build: the controls work, they just do not persist

// NO NVS OFF-DEVICE. The settings page is fully interactive on the desktop -- which is the point,
// since judging it is why the desktop build exists -- but a value set here lasts only as long as
// the process. Deliberately silent rather than logging a failure every time: on the desktop
// "settings did not persist" is the expected behaviour, not a fault worth reporting.
void load() {}
void save() {}

#endif  // ESP_PLATFORM

void setOpen(bool open)
{
    g_open = open;
    if (!g_root) return;
    if (open) {
        lv_obj_remove_flag(g_root, LV_OBJ_FLAG_HIDDEN);
        // RAISE IT ON OPEN, not once at build. cameraStep() calls lv_obj_move_foreground() on the
        // camera preview, and that runs long AFTER settingsBuild() -- so a panel raised only at
        // build time ends up underneath the preview and the lids.
        lv_obj_move_foreground(g_root);
    }
    else      lv_obj_add_flag(g_root, LV_OBJ_FLAG_HIDDEN);
}

Label* rowLabel(lv_obj_t* parent, const char* text, int y)
{
    auto* l = new Label(parent);
    l->setTextFont(&lv_font_montserrat_28);
    l->setTextColor(lv_color_hex(0xe8e8e8));
    l->setText(text);
    l->align(LV_ALIGN_TOP_LEFT, 60, y);
    return l;
}

}  // namespace

bool settingsAudioEnabled()     { return g_audio; }
bool settingsTelemetryVisible() { return g_telemetry; }
bool settingsReticleVisible()   { return g_reticle; }
bool settingsOwnsPanel()        { return g_open; }
void settingsOpen()             { setOpen(true); }

#if OPENDUBS_TOUCH_DEBUG
// RAW TOUCH CROSSHAIR -- AN INSTRUMENT, AND IT MUST BE ABSENT FROM A RELEASE.
// It settled the one question no amount of reading the source could: whether an LVGL press
// reaches the screen at all, and at which coordinates after the 90-degree rotation. It did its
// job -- presses arrive, in the right place.
//
// It shipped unconditionally until now, which is the exact failure the ship checklist exists to
// prevent: a robot's face drawing a red circle wherever anyone touches it. The flag is generated
// by build.sh and defaults OFF, so this is compiled out unless asked for.
lv_obj_t* g_cross    = nullptr;
lv_obj_t* g_crossLbl = nullptr;

void onAnyPress(lv_event_t*)
{
    lv_indev_t* indev = lv_indev_active();
    if (!indev || !g_cross) return;
    lv_point_t pt;
    lv_indev_get_point(indev, &pt);
    lv_obj_set_pos(g_cross, pt.x - 30, pt.y - 30);
    lv_obj_remove_flag(g_cross, LV_OBJ_FLAG_HIDDEN);
    static char buf[48];
    snprintf(buf, sizeof(buf), "touch %d,%d", (int)pt.x, (int)pt.y);
    if (g_crossLbl) lv_label_set_text(g_crossLbl, buf);
}

void crosshairBuild(lv_obj_t* scr)
{
    lv_obj_add_event_cb(scr, onAnyPress, LV_EVENT_PRESSED, nullptr);
    lv_obj_add_flag(scr, LV_OBJ_FLAG_CLICKABLE);

    g_cross = lv_obj_create(scr);
    lv_obj_remove_style_all(g_cross);
    lv_obj_remove_flag(g_cross, LV_OBJ_FLAG_CLICKABLE);
    lv_obj_set_size(g_cross, 60, 60);
    lv_obj_set_style_radius(g_cross, 30, 0);
    lv_obj_set_style_bg_opa(g_cross, LV_OPA_TRANSP, 0);
    lv_obj_set_style_border_width(g_cross, 5, 0);
    lv_obj_set_style_border_color(g_cross, lv_color_hex(0xff2d55), 0);
    lv_obj_add_flag(g_cross, LV_OBJ_FLAG_HIDDEN);
    lv_obj_move_foreground(g_cross);

    g_crossLbl = lv_label_create(scr);
    lv_obj_set_style_text_font(g_crossLbl, &lv_font_montserrat_32, 0);
    lv_obj_set_style_text_color(g_crossLbl, lv_color_hex(0xff2d55), 0);
    lv_obj_align(g_crossLbl, LV_ALIGN_BOTTOM_MID, 0, -20);
    lv_label_set_text(g_crossLbl, "no touch yet");
    lv_obj_move_foreground(g_crossLbl);
}
#else
void crosshairBuild(lv_obj_t*) {}
#endif

void settingsBuild()
{
    load();

    lv_obj_t* scr = lv_screen_active();

    // NO ENTRY TARGET HERE ANY MORE. This used to own an invisible 160x160 top-left corner,
    // and then the same corner with three dim dots as an affordance. Both were wrong: the dots
    // sat under the eye and could not be seen at all, and a control nobody can find is a control
    // nobody has. ui_hmi.cpp now takes a touch ANYWHERE on the face and opens the controller,
    // which carries a labelled SETTINGS button -- so this panel is reached by reading, not by
    // knowing. settingsOpen() is that button's target.
    crosshairBuild(scr);

    // ---- the panel itself, hidden until opened ----
    g_root = lv_obj_create(scr);
    lv_obj_remove_style_all(g_root);
    lv_obj_set_size(g_root, LV_PCT(100), LV_PCT(100));
    lv_obj_set_style_bg_opa(g_root, LV_OPA_COVER, 0);
    lv_obj_set_style_bg_color(g_root, lv_color_hex(0x14181c), 0);
    lv_obj_add_flag(g_root, LV_OBJ_FLAG_HIDDEN);
    lv_obj_move_foreground(g_root);

    auto* title = new Label(g_root);
    title->setTextFont(&lv_font_montserrat_40);
    title->setTextColor(lv_color_hex(0xffffff));
    title->setText("Settings");
    title->align(LV_ALIGN_TOP_LEFT, 60, 40);

    // ---- audio ----
    rowLabel(g_root, "Audio cues", 150);
    g_swAudio = std::make_unique<Switch>(g_root);
    g_swAudio->align(LV_ALIGN_TOP_LEFT, 420, 148);
    if (g_audio) lv_obj_add_state(g_swAudio->get(), LV_STATE_CHECKED);
    g_swAudio->onValueChanged().connect([](bool on) {
        g_audio = on;
        save();
        // Render the PCM only now, when someone has asked for audio -- not at boot. ~306 kB of
        // internal DRAM is not worth spending on a feature that is off.
        if (on) cuesBegin();
        mclog::tagInfo(kTag, "audio {}", on ? "on" : "off");
    });

    rowLabel(g_root, "Volume", 240);
    g_slVol = std::make_unique<Slider>(g_root);
    g_slVol->setSize(420, 20);
    g_slVol->align(LV_ALIGN_TOP_LEFT, 420, 248);
    g_slVol->setRange(0, 100, false);
    g_slVol->setValue(GetHAL()->getSpeakerVolume());

    g_lblVol = std::make_unique<Label>(g_root);
    g_lblVol->setTextFont(&lv_font_montserrat_28);
    g_lblVol->setTextColor(lv_color_hex(0xffd24a));
    g_lblVol->setText(std::to_string(GetHAL()->getSpeakerVolume()));
    g_lblVol->align(LV_ALIGN_TOP_LEFT, 880, 240);

    g_slVol->onValueChanged().connect([](int32_t v) {
        // Straight through the HAL, which already owned volume -- panel_spk_volume.cpp does
        // exactly this. Nothing here needed inventing.
        GetHAL()->setSpeakerVolume((uint8_t)std::clamp<int32_t>(v, 0, 100));
        if (g_lblVol) g_lblVol->setText(std::to_string(GetHAL()->getSpeakerVolume()));
        save();
    });

    // ---- on-screen telemetry ----
    rowLabel(g_root, "On-screen telemetry", 340);
    g_swTelem = std::make_unique<Switch>(g_root);
    g_swTelem->align(LV_ALIGN_TOP_LEFT, 420, 338);
    if (g_telemetry) lv_obj_add_state(g_swTelem->get(), LV_STATE_CHECKED);
    g_swTelem->onValueChanged().connect([](bool on) {
        g_telemetry = on;
        save();
    });

    // ---- tracking reticle ----
    rowLabel(g_root, "Tracking reticle", 380);
    g_swRetic = std::make_unique<Switch>(g_root);
    g_swRetic->align(LV_ALIGN_TOP_LEFT, 420, 378);
    if (g_reticle) lv_obj_add_state(g_swRetic->get(), LV_STATE_CHECKED);
    g_swRetic->onValueChanged().connect([](bool on) {
        g_reticle = on;
        save();
    });

    auto* note = new Label(g_root);
    note->setTextFont(&lv_font_montserrat_20);
    note->setTextColor(lv_color_hex(0x8a94a0));
    note->setText("Dev instruments (camera preview, perception overlay, serial)\n"
                  "are compiled out of a release and are not listed here.");
    note->align(LV_ALIGN_TOP_LEFT, 60, 450);

    // ---- close ----
    g_close = std::make_unique<Container>(g_root);
    g_close->setSize(220, 90);
    g_close->align(LV_ALIGN_BOTTOM_RIGHT, -60, -50);
    g_close->setOpa(0);
    g_close->onClick().connect([]() { setOpen(false); });

    auto* closeLbl = new Label(g_root);
    closeLbl->setTextFont(&lv_font_montserrat_32);
    closeLbl->setTextColor(lv_color_hex(0x7ad1ff));
    closeLbl->setText("Close");
    closeLbl->align(LV_ALIGN_BOTTOM_RIGHT, -110, -75);
}

#else   // OPENDUBS_TOUCH_UI == 0

// COMPILED OUT ENTIRELY. The whole API becomes no-ops so app_face.cpp needs no #ifdef and the
// linker drops the widgets, the NVS access and smooth_ui_toolkit's instantiations with it.
// Audio reports DISABLED rather than enabled: with no panel there is no way to turn a tone off,
// and a face that cannot be silenced is the wrong default.
void settingsBuild()             {}
void settingsOpen()              {}
bool settingsOwnsPanel()         { return false; }
bool settingsAudioEnabled()      { return false; }
bool settingsTelemetryVisible()  { return false; }
bool settingsReticleVisible()    { return false; }

#endif  // OPENDUBS_TOUCH_UI
